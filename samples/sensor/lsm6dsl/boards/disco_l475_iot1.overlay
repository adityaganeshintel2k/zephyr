/* disco_l475_iot1's DTS has the lis3mdl node but no magn0 alias/label this sample needs */
&i2c2 {
	lis3mdl: lis3mdl-magn@1e {
		compatible = "st,lis3mdl-magn";
		reg = <0x1e>;
	};
};

/ {
	aliases {
		magn0 = &lis3mdl;
	};
};
