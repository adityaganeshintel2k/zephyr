## boards/intel/ish/Kconfig
```kconfig
# Copyright (c) 2024 Intel Corporation
#
# SPDX-License-Identifier: Apache-2.0

config BOARD_INTEL_ISH_5_4_1
	bool
	select SIMICS_TARGET

config BOARD_INTEL_ISH_5_8_0
	bool
	select SIMICS_TARGET
```

## dts/bindings/cpu/cdns,tensilica-xtensa-lx8.yaml
```yaml
# Copyright (c) 2021 Espressif Systems (Shanghai) Co., Ltd.
# SPDX-License-Identifier: Apache-2.0

description: Cadence Tensilica Xtensa LX8 CPU

compatible: "cdns,tensilica-xtensa-lx8"

include: cpu.yaml

properties:
  clock-source:
    type: int
    description: cpu clock source
```

## dts/bindings/mm/intel,smmu.yaml
```yaml
# SPDX-License-Identifier: Apache-2.0
#
# Copyright (c) 2026 Intel Corporation

description: Intel System Memory Mapping Unit (SMMU)

compatible: "intel,smmu"

include: [mm_drv.yaml]

properties:
  reg:
    required: true

  page-size:
    required: true
    type: int
    enum:
      - 4096
      - 8192
    description: |
      Page size addressable by each translation entry.
```
