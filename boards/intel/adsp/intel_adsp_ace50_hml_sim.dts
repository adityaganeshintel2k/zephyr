/*
 * Copyright (c) 2026 Intel Corporation
 *
 * SPDX-License-Identifier: Apache-2.0
 */

/dts-v1/;

#include <intel/intel_adsp_ace50.dtsi>

/ {
	model = "intel_adsp_ace50_hml_sim";
	compatible = "intel";
};
