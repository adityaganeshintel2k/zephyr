## tests/kernel/mem_protect/mem_protect/boards/intel_adsp_ace30_ptl_sim.conf
```kconfig
# Copyright (c) 2023 Intel Corporation
# SPDX-License-Identifier: Apache-2.0

# test_kobject_perm_error fails when the child_thread
# runs on different CPUs consecutively. Any attempt to
# debug would result in it passing so the root cause is
# not determined. Speculation is that due to the thread
# object and all the kernel objects are created in stack,
# the cache may play a part in the failure. For example,
# adding a little delay after k_thread_join() would make
# the test pass. However, since other platforms are
# passing, there is no justification to add that delay.
# So instead, force this to use 1 CPU for now when
# running on simulator. Hopefully, this won't be
# an issue on real hardware.
CONFIG_MP_MAX_NUM_CPUS=1
```
